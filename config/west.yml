## config/west.yml
```yaml
manifest:
  defaults:
    revision: v0.3
  remotes:
    - name: zmkfirmware
      url-base: https://github.com/zmkfirmware
    - name: carrefinho                          
      url-base: https://github.com/carrefinho
    # Additional modules containing boards/shields/custom code can be listed here as well
    # See https://docs.zephyrproject.org/3.2.0/develop/west/manifest.html#projects
  projects:
    - name: zmk
      remote: zmkfirmware
      import: app/west.yml
    - name: levels54
      url: https://github.com/Good-Great-Grand-Wonderful/levels54
      revision: main
      path: modules/levels54
    - name: gggw-zmk-keebs
      url: https://github.com/Good-Great-Grand-Wonderful/gggw-zmk-keebs
      revision: main
      path: modules/gggw-zmk-keebs
    - name: prospector-zmk-module
      remote: carrefinho
      revision: main   
  self:
    path: config
```
